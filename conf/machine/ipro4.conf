## conf/machine/ipro4.conf
```bitbake
#@TYPE: Machine
#@Name: EMERSON IPRO4
#@DESCRIPTION: Machine configuration for Emerson iPro4 board

require include/at91sam9.inc

MACHINE_FEATURES = "kernel26 apm ext4 usbgadget"
KERNEL_DEVICETREE = "ipro4.dtb"

IMAGE_FSTYPES += " ubi tar.gz"

# NAND
MKUBIFS_ARGS = " -e 129024 -c 2047 -m 2048  -x lzo"
UBINIZE_ARGS = " -m 2048 -p 128KiB -s 512"

UBI_VOLNAME = "rootfs"

UBOOT_MACHINE = "${MACHINE}_nandflash_config"
UBOOT_ENTRYPOINT = "0x20008000"
UBOOT_LOADADDRESS = "0x20008000"
```
